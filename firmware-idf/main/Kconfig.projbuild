## firmware-idf/main/Kconfig.projbuild
```kconfig
menu "LEAF inverter bridge"

    menu "VCM bus (ESP32 TWAI)"
        config BRIDGE_TWAI_TX_GPIO
            int "TWAI TX GPIO"
            range 0 33
            default 5
        config BRIDGE_TWAI_RX_GPIO
            int "TWAI RX GPIO"
            range 0 39
            default 4
    endmenu

    menu "Inverter bus (MCP2515)"
        config BRIDGE_MCP2515_SCK_GPIO
            int "SPI SCK GPIO"
            default 26
        config BRIDGE_MCP2515_MOSI_GPIO
            int "SPI MOSI GPIO (MCP2515 SI)"
            default 19
        config BRIDGE_MCP2515_MISO_GPIO
            int "SPI MISO GPIO (MCP2515 SO)"
            default 18
        config BRIDGE_MCP2515_CS_GPIO
            int "SPI CS GPIO"
            default 15
        config BRIDGE_MCP2515_INT_GPIO
            int "INT GPIO"
            default 22
        config BRIDGE_MCP2515_SPI_HZ
            int "SPI clock (Hz)"
            range 1000000 10000000
            default 8000000

        choice BRIDGE_MCP2515_CRYSTAL
            prompt "MCP2515 crystal"
            default BRIDGE_MCP2515_CRYSTAL_8MHZ
            config BRIDGE_MCP2515_CRYSTAL_8MHZ
                bool "8 MHz (sample point 75 %)"
            config BRIDGE_MCP2515_CRYSTAL_16MHZ
                bool "16 MHz (sample point 87.5 %)"
        endchoice
    endmenu

    menu "Wi-Fi access point"
        config BRIDGE_WIFI_SSID
            string "Factory network name (SSID)"
            default "Can-bridgeINV"
            help
                Initial access point name; can be changed in the web UI.
        config BRIDGE_WIFI_PASSWORD
            string "Factory Wi-Fi password (WPA2/WPA3, 8-63 characters)"
            default "Password"
            help
                Initial access point password. It can be changed in the web UI
                (Device > Wi-Fi network) and is then stored in NVS; a factory
                reset returns to this value.
        config BRIDGE_WIFI_CHANNEL
            int "Channel"
            range 1 13
            default 6
        config BRIDGE_WIFI_MAX_CONNECTIONS
            int "Maximum clients"
            range 1 4
            default 2
    endmenu

    menu "Web UI and security"
        config BRIDGE_ADMIN_PASSWORD
            string "Factory admin password (empty = factory Wi-Fi password)"
            default ""
            help
                Password of the web UI and API. While this factory default is in
                use the bridge refuses every change except setting a new admin
                password, so each device ends up with its own password. The new
                password is stored as a salted PBKDF2-HMAC-SHA256 hash in NVS.
        config BRIDGE_CAPTIVE_PORTAL
            bool "Captive portal (phones open the configuration page on joining)"
            default y
            help
                Runs a DNS server that answers every name with the bridge's address
                and redirects the operating systems' connectivity checks to the
                configuration page ("Sign in to network").
    endmenu

    config BRIDGE_SELFTEST_REQUIRE_CAN
        bool "OTA self test: roll back unless both CAN controllers start"
        default y
        help
            After a firmware update the new image only confirms itself (cancelling
            the automatic rollback) if the TWAI node and the MCP2515 both start.

    config BRIDGE_QEMU_OPENETH
        bool "TEST ONLY: use QEMU OpenCores Ethernet instead of Wi-Fi"
        depends on ETH_USE_OPENETH
        default n
        help
            For the QEMU end-to-end test (test/qemu_e2e.py). Never enable for hardware.

    config BRIDGE_STATUS_LED_GPIO
        int "Status LED GPIO (-1 = none)"
        range -1 33
        default 2

endmenu
```

## lib/leaf_can/Kconfig
```kconfig
menu "leaf_can (Nissan LEAF EV-CAN)"

    config LEAF_CAN_TORQUE_110KW_PERMILLE
        int "Drive torque multiplier for the 110 kW inverter (1/1000)"
        range 500 2000
        default 900
        help
            Positive torque requests in D are multiplied by this value / 1000.
            900 is the value firmware v1.3.0 shipped with (it REDUCES torque).
            The Dala upstream firmware uses 1320 (x1.32).

    config LEAF_CAN_TORQUE_160KW_PERMILLE
        int "Drive torque multiplier for the 160 kW inverter (1/1000)"
        range 500 2000
        default 1600
        help
            Upstream uses 1400 and suggests 1400..1600 for a more aggressive pedal.
            Results that no longer fit the 12-bit signal are saturated.

    config LEAF_CAN_REGEN_PERMILLE
        int "Regen torque multiplier (1/1000)"
        range 500 2000
        default 1100

    config LEAF_CAN_EMULATE_1F2_GROUP
        bool "Synthesise the 0x1F2-driven ZE1 messages (0x1C2/0x108/0x1CB/0x1ED)"
        default n
        help
            Off in firmware v1.3.0, which notes they must stay disabled with a 62 kWh pack.

    config LEAF_CAN_MIN_SOC_PERMILLE
        int "Do not modify torque below this SOC (0.1 %, 0 = off)"
        range 0 1000
        default 0
        help
            Fuse protection for small (24 kWh) packs; upstream used 700 (70 %).

endmenu
```
